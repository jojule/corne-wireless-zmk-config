## Kconfig
```kconfig
config CORNE_UTILITY
    bool "Corne keymap reference and named status displays"
    default y
    depends on ZMK_DISPLAY
    select LV_USE_CANVAS
    select LV_USE_IMAGE
```

## dts/bindings/behaviors/corne,lookup.yaml
```yaml
# SPDX-License-Identifier: MIT
description: Display-only key lookup and guarded entry
compatible: "corne,lookup"
include: one_param.yaml
```

## dts/bindings/behaviors/corne,utility-relay.yaml
```yaml
# SPDX-License-Identifier: MIT
description: Internal display-state receiver for the existing encrypted split link
compatible: "corne,utility-relay"
include: two_param.yaml
```
